#include <behaviors.dtsi>
#include <dt-bindings/zmk/keys.h>
#include <dt-bindings/zmk/bt.h>

/{
    keymap {   
        default_layer {
            bindings = <
                &kp N1     &kp N1     &kp N1     &kp N1     &kp N1     &kp N1
                &kp N1     &kp N1     &kp N1     &kp N1     &kp N1     &kp N1
                &kp N1     &kp N1     &kp N1     &kp N1     &kp N1     &kp N1
                &kp N1     &kp N1     &kp N1     &kp N1     &kp N1     &kp N1
                &kp N1     &kp N1     &kp N1     &kp N1     &kp N1     &kp N1
            >;
        };
    };
};