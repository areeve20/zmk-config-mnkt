#include <behaviors.dtsi>
#include <dt-bindings/zmk/keys.h>
#include <dt-bindings/zmk/bt.h>

/{
    keymap {
        compatable = "zmk,keymap";

        default_layer {
            bindings = <
                &kp KP_ESC      &kp KP_N1       &kp KP_N2       &kp KP_N3       &kp KP_N4       &kp KP_N5
                &kp KP_TAB      &kp KP_q       &kp KP_w       &kp KP_e       &kp KP_r       &kp KP_t
                &kp KP_CAPS      &kp KP_a       &kp KP_s       &kp KP_d       &kp KP_f       &kp KP_g
                &kp KP_L.SHIFT      &kp KP_z       &kp KP_x       &kp KP_c       &kp KP_v       &kp KP_b
                &kp KP_LCTRL      &kp KP_LWIN       &kp KP_LALT       &kp KP_SPACE       &mo 1 
            >;
        };

        bt_layer {
            bindings = <
                &none      &bt BT_SEL 0       &bt BT_SEL 1       &bt BT_SEL 2       &none       &bootloader
                &none      &none       &none       &none       &none       &boot BT_CLEAR
                &none      &none       &none       &none       &none       &none
                &none      &none       &none       &none       &none       &none
                &none      &none       &none       &none       &none 
            >;
        };
    };
};